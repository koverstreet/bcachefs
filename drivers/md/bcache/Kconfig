## drivers/md/bcache/Kconfig
```kconfig
config BCACHE
	tristate "Block device as cache"
	select CLOSURES
	---help---
	Allows a block device to be used as cache for other devices; uses
	a btree for indexing and the layout is optimized for SSDs.

	See Documentation/bcache.txt for details.

config BCACHE_DEBUG
	bool "Bcache debugging"
	depends on BCACHE
	---help---
	Don't select this option unless you're a developer

	Enables extra debugging tools, allows expensive runtime checks to be
	turned on.
```

## drivers/staging/ctagmod/Kconfig
```kconfig
# SPDX-License-Identifier: GPL-2.0
config CTAGMOD
	tristate "Code tagging test module"
	depends on CODE_TAGGING
	default m
	help
	  Code tagging test module.

	  To compile this driver as a module, choose M here: the module
	  will be called ctagmod.
```

## fs/bcachefs/Kconfig
```kconfig
config BCACHEFS_FS
	tristate "bcachefs filesystem support"
	depends on BLOCK
	depends on (64BIT || LBDAF)
	select EXPORTFS
	select CLOSURES
	select LIBCRC32C
	select FS_POSIX_ACL
	select LZ4_COMPRESS
	select LZ4_DECOMPRESS
	select ZLIB_DEFLATE
	select ZLIB_INFLATE
	select CRYPTO_SHA256
	select CRYPTO_CHACHA20
	select CRYPTO_POLY1305
	select KEYS
	select COMPACTION
	---help---
	The bcachefs filesystem - a modern, copy on write filesystem, with
	support for multiple devices, compression, checksumming, etc.

config BCACHEFS_DEBUG
	bool "bcachefs debugging"
	depends on BCACHEFS_FS
	---help---
	Don't select this option unless you're a developer

	Enables extra debugging tools, allows expensive runtime checks to be
	turned on.
```

## lib/erasure_code/Kconfig
```kconfig
config ERASURE_CODE
	tristate "GF(256) erasure coding"
	select RAID6_PQ
    select XOR_BLOCKS
	---help---
	This option provides generalized Erasure Coding fucntions as an 
	alternative to RAID P+Q for high resiliency storage arrays. 

config ERASURE_CODE_LARGE_GF_TABLES
	bool "Large GF lookup tables"
	depends on ERASURE_CODE
	---help---
	Use large lookup tables (64KiB) for base EC implementations. Enable
	for a small performance increase on platforms without SIMD acceleration.

config ERASURE_CODE_LARGE_GF_TABLES
	bool "Large GF lookup tables"
	depends on ERASURE_CODE
	---help---
	Use large lookup tables (64KiB) for base EC implementations. Enable
	for a small performance increase on platforms without SIMD acceleration.
```

## lib/math/Kconfig
```kconfig
# SPDX-License-Identifier: GPL-2.0-only
config CORDIC
	tristate "CORDIC algorithm"
	help
	  This option provides an implementation of the CORDIC algorithm;
	  calculations are in fixed point. Module will be called cordic.

config PRIME_NUMBERS
	tristate "Simple prime number generator for testing"
	help
	  This option provides a simple prime number generator for test
	  modules.

	  If unsure, say N.

config RATIONAL
	tristate

config MEAN_AND_VARIANCE
	tristate "fast incremental integer mean and vairance module"
	help
	  This option provides functions for calculating mean and standard
      	  deviation incrementally, standard and expotentially weighted variants"

config MEAN_AND_VARIANCE_UNIT_TEST
	tristate "mean_and_variance unit tests" if !KUNIT_ALL_TESTS
	depends on MEAN_AND_VARIANCE && KUNIT
	default KUNIT_ALL_TESTS
```

## ubuntu/xr-usb-serial/Kconfig
```kconfig
config USB_SERIAL_EXAR
	bool "Exar USB UART (serial port) driver"
	depends on X86 || X86_64
	depends on TTY
	depends on GPIOLIB
	default y
	---help---
	  Say Y here if you want to use a Exar USB to Serial device.

	  To compile this driver as a module, choose M here: the
	  module will be called xr_usb_serial
```
